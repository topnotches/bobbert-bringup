/include/ "system-conf.dtsi"
/
{
	chosen {
		bootargs = "earlycon console=ttyPS0,115200 root=/dev/mmcblk1p2 rw rootwait";
		stdout-path = "serial0:115200n8";
	};
};

&sdhci1 {
	disable-wp;
	no-1-8-v;
};

&gem0 {
	local-mac-address = [02 11 22 33 44 55];
};
